## drivers/display/Kconfig.ls0xxvcom
```kconfig
# Copyright (c) 2025 eden ariel and ember ana
# SPDX-License-Identifier: Apache-2.0

config DISPLAY_LS0XX_VCOM
	bool "sharp memory display with serial vcom support"
	default y
	depends on DT_HAS_SHARP_LS0XX_VCOM_ENABLED
	select SPI
	help
	  modified sharp memory display driver to add serial vcom support

config LS0XX_VCOM_THREAD_PRIO
	int "Priority for the VCOM inversion thread"
	default 3
	depends on DISPLAY_LS0XX_VCOM
	help
	  Set the VCOM inversion thread priority
```
