## Kconfig
```kconfig
# (c) 2025 eden ariel and ember ana
# SPDX-License-Identifier: Apache-2.0

rsource "drivers/Kconfig"
```

## drivers/Kconfig
```kconfig
# Copyright (c) 2025 eden ariel and ember ana
# SPDX-License-Identifier: Apache-2.0

rsource "display/Kconfig"
```

## drivers/display/Kconfig
```kconfig
# Copyright (c) 2025 eden ariel and ember ana
#
# SPDX-License-Identifier: Apache-2.0

if DISPLAY

source "$(ZEPHYR_LS0XXVCOM_MODULE_DIR)/drivers/display/Kconfig.ls0xxvcom"

endif # DISPLAY
```

## dts/bindings/display/sharp,ls0xx-vcom.yaml
```yaml
# Copyright (c) 2020, Rohit Gujarathi
# Copyright (c) 2025, eden ariel
# SPDX-License-Identifier: Apache-2.0

description: Sharp memory display controller with serial VCOM inversion

compatible: "sharp,ls0xx-vcom"

include: [spi-device.yaml, display-controller.yaml]

properties:
  extcomin-gpios:
    type: phandle-array
    description: EXTCOMIN pin

      The EXTCOMIN pin is where a square pulse for toggling VCOM will
      be given

  extcomin-frequency:
    type: int
    description: EXTCOMIN pin toggle frequency

      The frequency with which the EXTCOMIN pin should be toggled. See
      datasheet of particular display. Higher frequency gives better
      contrast while low frequency saves power.

  disp-en-gpios:
    type: phandle-array
    description: DISPLAY pin

      The DISPLAY pin controls if the LCD displays memory contents or
      white screen. If defined, the pin will be set high during driver
      initialization. display blanking apis can be used to control it.

  serial-vcom-inversion:
    type: boolean
    description: Send serial VCOM inversion commands

      Driver creates a thread to send inversion commands over SPI. 
      Enable when EXTCOMIN is not configured and VCOM inversion is not
      application-managed.

  serial-vcom-interval:
    type: int
    description: Serial VCOM inversion interval

      VCOM inversion interval in milliseconds. This value is used when
      there is no EXTCOMIN configured and serial-vcom inversion is set.
      If not configured, 1000ms will be used.
```
